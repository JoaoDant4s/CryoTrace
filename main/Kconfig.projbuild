## main/Kconfig.projbuild
```kconfig
menu "CryoTrace"

    config CRYO_BOX_NAME
        string "Thermal box name"
        default "box01"
        help
            Readable name of the box, used in its MQTT topics
            (cryotrace/{box_name}/...). Its keccak256 hash is the boxId the
            contract and the signed events use.

    config CRYO_BATCH_NAME
        string "Initial batch name"
        default "batch-demo-001"
        help
            Batch used until another one is stored on the device (its
            keccak256 hash is the batchId). The box
            carries one batch per trip and is reused for later batches; each
            new batch is set without reflashing and must be assigned to the
            box in the contract (registerBatch).

    config CRYO_TEMP_MIN_DECI
        int "Range lower limit (tenths of °C)"
        range -1000 1000
        default 20
        help
            20 = 2.0 °C. The usual range for refrigerated vaccines is 2–8 °C.

    config CRYO_TEMP_MAX_DECI
        int "Range upper limit (tenths of °C)"
        range -1000 1000
        default 80
        help
            80 = 8.0 °C.

    config CRYO_ENTER_TIME_MS
        int "Time out of range to enter ANOMALY (ms)"
        range 0 3600000
        default 3000

    config CRYO_EXIT_TIME_MS
        int "Time back in range to return to NORMAL (ms)"
        range 0 3600000
        default 3000

    config CRYO_SAMPLE_PERIOD_MS
        int "Sensor sampling period (ms)"
        range 50 60000
        default 500
        help
            Must be much smaller than the enter and exit times: the state
            change happens between T and T + period after the start.

    choice CRYO_FILTER
        prompt "Reading filter"
        default CRYO_FILTER_MEDIAN
        help
            Smooths the sensor readings before the anomaly state machine.
            The comparison in analysis/ (detection delay, peak error, false
            alarms) favours the median: it discards isolated glitches,
            which a moving average spreads over its whole window and can
            turn into a false anomaly.

        config CRYO_FILTER_MEDIAN
            bool "Running median"
        config CRYO_FILTER_MOVING_AVERAGE
            bool "Moving average"
    endchoice

    config CRYO_FILTER_WINDOW
        int "Filter window (samples)"
        range 1 9 if CRYO_FILTER_MEDIAN
        range 1 16
        default 5 if CRYO_FILTER_MEDIAN
        default 4
        help
            Median: use an odd number (5 = 2.5 s at 500 ms sampling; it
            ignores up to 2 bad readings in a row). Moving average: keep the
            window shorter than the anomaly enter time.

    choice CRYO_SENSOR
        prompt "Temperature sensor"
        default CRYO_SENSOR_SIMULATED

        config CRYO_SENSOR_SIMULATED
            bool "Simulated (test profile, no hardware)"
    endchoice

endmenu

menu "CryoTrace - Network"

    choice CRYO_NET
        prompt "Network link"
        default CRYO_NET_WIFI
        help
            The box connects on its own, without depending on the vehicle.
            Cellular is the target design; Wi-Fi (e.g. a phone hotspot)
            stands in for it in the prototype.

        config CRYO_NET_WIFI
            bool "Wi-Fi (prototype, e.g. phone hotspot)"

        config CRYO_NET_CELLULAR
            bool "Cellular modem: NB-IoT / LTE-M (SIMCom SIM7080G)"
    endchoice

    # esp_modem brings the modem up as a PPP interface.
    config CRYO_NET_NEEDS_PPP
        bool
        default y if CRYO_NET_CELLULAR
        select LWIP_PPP_SUPPORT

    if CRYO_NET_WIFI

        config CRYO_WIFI_SSID
            string "Wi-Fi SSID"
            default ""
            help
                Empty = run without network. Stored in sdkconfig, which is in .gitignore.

        config CRYO_WIFI_PASSWORD
            string "Wi-Fi password"
            default ""

    endif

    if CRYO_NET_CELLULAR

        choice CRYO_CELL_RAT
            prompt "Radio technology"
            default CRYO_CELL_RAT_NBIOT

            config CRYO_CELL_RAT_NBIOT
                bool "NB-IoT"

            config CRYO_CELL_RAT_LTEM
                bool "LTE-M (Cat-M)"

            config CRYO_CELL_RAT_AUTO
                bool "Automatic (LTE-M or NB-IoT)"
        endchoice

        config CRYO_CELL_APN
            string "APN"
            default ""
            help
                Access point name of the SIM's operator for NB-IoT/LTE-M.

        config CRYO_CELL_SIM_PIN
            string "SIM PIN"
            default ""
            help
                Only needed if the SIM is PIN-locked. Stored in sdkconfig (not committed).

        config CRYO_CELL_UART_TX
            int "UART TX GPIO (to modem RX)"
            range 0 48
            default 17

        config CRYO_CELL_UART_RX
            int "UART RX GPIO (from modem TX)"
            range 0 48
            default 18

        config CRYO_CELL_UART_BAUD
            int "UART baud rate"
            default 115200

        config CRYO_CELL_PWRKEY_GPIO
            int "PWRKEY GPIO (-1 = not connected)"
            range -1 48
            default -1
            help
                Pulsed to power the modem on when it does not answer.

        config CRYO_CELL_PWRKEY_ACTIVE_HIGH
            bool "PWRKEY GPIO is active high (driven through a transistor)"
            depends on CRYO_CELL_PWRKEY_GPIO >= 0
            default y

    endif

    config CRYO_NTP_SERVER
        string "NTP server"
        default "pool.ntp.org"

endmenu

menu "CryoTrace - MQTT"

    config CRYO_MQTT_BROKER_URI
        string "Broker URI"
        default "mqtts://your-deployment.ala.us-east-1.emqxsl.com:8883"
        help
            mqtts:// for TLS (e.g. EMQX Cloud Serverless, port 8883; the server certificate is
            checked against the CA bundle shipped with ESP-IDF). mqtt:// only
            for a local test broker.

    config CRYO_MQTT_USERNAME
        string "Username"
        default ""

    config CRYO_MQTT_PASSWORD
        string "Password"
        default ""
        help
            Stored in sdkconfig (git-ignored), like the Wi-Fi password.

    config CRYO_MQTT_KEEPALIVE_S
        int "Keep-alive interval (s)"
        range 30 3600
        default 300
        help
            How often an idle connection pings the broker. The broker marks
            the box offline after 1.5x this time without hearing from it.
            Each ping costs ~180 B with TLS and TCP/IP: at 30 s that is
            524 kB/day, far more than the signed events themselves; at
            300 s, 52 kB/day. Some cellular networks drop idle TCP
            connections after a few minutes: the box then notices on its
            next publish and reconnects, and no event is lost (they wait in
            the outbox until the broker acknowledges them).

endmenu

menu "CryoTrace - Blockchain"

    config CRYO_CHAIN_ID
        int "Chain ID"
        range 1 2147483647
        default 11155111
        help
            Network of the CryoTrace contract (11155111 = Sepolia). Part of the
            EIP-712 domain: a signature is only valid on this network.

    config CRYO_CONTRACT_ADDRESS
        string "CryoTrace contract address"
        default "0xF8A328b314C89Ef22E3494886A00419Dcc434Dd4"
        help
            0x-prefixed address of the deployed contract. Part of the EIP-712
            domain: a signature is only valid for this contract.

endmenu
```
